## components/lgal_core/Kconfig
```kconfig
# SPDX-FileCopyrightText: 2026 Lars Greiss / LG Aquatic Life
# SPDX-License-Identifier: GPL-3.0-or-later

menu "LG Aquatic Life Core"

    config LGAL_DEVICE_TYPE
        string "Device type (hostname/topic prefix)"
        default "doser"
        help
            Used for the hostname (lgal-<type>-xxxx) and later the MQTT namespace
            lg-aquatic-life/<type>/<id>/.

    config LGAL_SETUP_AP_TIMEOUT_MIN
        int "Runtime of the setup AP opened via the button (minutes)"
        default 30
        range 5 240

    config LGAL_OTA_CONFIRM_DELAY_S
        int "Stable runtime until a new OTA image counts as valid (s)"
        default 60
        range 10 600

    config LGAL_OTA_CONFIRM_WAIT_S
        int "Wait for the network before a new OTA image is rolled back (s)"
        default 300
        range 0 3600
        help
            A new image that is not reachable after LGAL_OTA_CONFIRM_DELAY_S is
            checked again every 10 s for this long (router restarting, Wi-Fi still
            connecting) before it is rolled back. 0 = roll back at once.

    config LGAL_OTA_SOURCE
        string "Release manifest of the update source (factory setting)"
        default ""
        help
            Address of manifest.json of the published releases, e.g.
            https://github.com/<owner>/<repo>/releases/latest/download/manifest.json.
            Empty = no update source; it can be changed in the engineering menu.

    config LGAL_OTA_SOURCE_BETA
        string "Release manifest of the beta channel (factory setting)"
        default ""
        help
            Address of manifest.json of the beta channel (newest release candidate
            or release), e.g.
            https://github.com/<owner>/<repo>/releases/download/channel-beta/manifest.json.
            Empty = no beta channel. The admin can choose it in the pro view while
            the update source is the factory one (LGAL_OTA_SOURCE).

    config LGAL_ETH_SPI_CLOCK_MHZ
        int "W5500 SPI clock (MHz)"
        default 20
        range 1 40

    config LGAL_TIMEZONE
        string "Time zone (POSIX TZ, default until setup)"
        default "CET-1CEST,M3.5.0,M10.5.0/3"

    config LGAL_NTP_SERVER
        string "NTP server (default until setup)"
        default "pool.ntp.org"

endmenu
```
